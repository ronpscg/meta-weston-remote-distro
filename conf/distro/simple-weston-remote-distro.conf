## conf/distro/simple-weston-remote-distro.conf
```bitbake
#
# An example of subclassing a distro, primarily used for testing alternate configuration
# combinations on the Yocto Project autobuilder
#
# This particular one is literally used only to select pam without modifying local.conf, in a non-intrusive way.
#
# You can ignore the following warning, or otherwise remove the files from the layer.conf to avoid it
# WARNING: No bb files in default matched BBFILE_PATTERN_meta-weston-remote-distro '^/home/ron/yocto/other-layers/meta-weston-remote-distro/
require conf/distro/poky.conf

DISTRO_NAME = "simple-weston-remote-distro"
DISTRO_DESCRIPTION = "A simple distro for demonstrating remote weston with a minimal set of features without \
					  modifying anything in local.conf other than MACHINE and DISTRO."
DISTRO_VERSION = "1.0"
DISTROOVERRIDES = "poky:simple-weston-remote-distro"

DISTRO_FEATURES:append = " pam"

# This is really more of a hack, but it works for the purpose of this distro
# Remove it if you don't need it
DISTRO_EXTRA_RDEPENDS:append = " hacky-wlan0-connect"
```

## conf/layer.conf
```bitbake
# We have a conf and classes directory, add to BBPATH
BBPATH .= ":${LAYERDIR}"

# We have recipes-* directories, add to BBFILES
BBFILES += "${LAYERDIR}/recipes-*/*/*.bb \
            ${LAYERDIR}/recipes-*/*/*.bbappend"

BBFILE_COLLECTIONS += "meta-weston-remote-distro"
BBFILE_PATTERN_meta-weston-remote-distro = "^${LAYERDIR}/"
BBFILE_PRIORITY_meta-weston-remote-distro = "6"

LAYERDEPENDS_meta-weston-remote-distro = "core"
LAYERSERIES_COMPAT_meta-weston-remote-distro = "whinlatter"
```
